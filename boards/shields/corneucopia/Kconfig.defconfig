## boards/shields/corneucopia/Kconfig.defconfig
```kconfig
if SHIELD_corneucopia_left

config ZMK_KEYBOARD_NAME
    default "Corneucopia"

config ZMK_SPLIT_ROLE_CENTRAL
    default y

endif

if SHIELD_CORNEUCOPIA_LEFT || SHIELD_CORNEUCOPIA_RIGHT

config ZMK_SPLIT
    default y

endif
```

## boards/shields/corneucopia/Kconfig.shield
```kconfig
config SHIELD_CORNEUCOPIA_LEFT
    def_bool $(shields_list_contains,corneucopia_left)
config SHIELD_CORNEUCOPIA_RIGHT
    def_bool $(shields_list_contains,corneucopia_right)
```

## config/boards/shields/corneucopia/Kconfig.defconfig
```kconfig
if SHIELD_corneucopiaLeft

config ZMK_KEYBOARD_NAME
    default "Corneucopia"

config ZMK_SPLIT_ROLE_CENTRAL
    default y

endif

if SHIELD_corneucopiaLeft || SHIELD_corneucopiaRight

config ZMK_SPLIT
    default y

endif
```

## config/boards/shields/corneucopia/Kconfig.shield
```kconfig
config SHIELD_corneucopiaLeft
    def_bool $(shields_list_contains,corneucopiaLeft)
config SHIELD_corneucopiaRight
    def_bool $(shields_list_contains,corneucopiaRight)
```
